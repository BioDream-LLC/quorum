#pragma once

// The binding layer: physical signals to asserted propositions.
//
// This is the most dangerous component in the product, and it is dangerous for a subtle reason. Everything above it
// -- the framework, the arbiter, the witness -- is auditable: every inference is an edge, every verdict cites the
// arguments that produced it. The binding layer is where a number becomes a proposition, and a threshold buried in
// C is a diagnostic decision that no witness will ever mention. Move one constant and the machine reaches a
// different conclusion with an explanation that never refers to the change.
//
// So this component is deliberately kept incapable of judgement. It answers exactly one question per observation --
// "did the plant assert this?" -- and every constant it uses comes from the casebook source, where it is reviewed,
// versioned and carried in the provenance block. There is no tuning parameter here that an engineer cannot read in
// the .cb file.
//
// THE CENTRAL REQUIREMENT: a sensor that cannot be believed must not look like a sensor reporting nothing.
//
// The witness work already established this: "no sensor asserted vibration" and "there is no vibration" are
// different statements, and a dead sensor produces the first while reading exactly like the second. Under closed
// world an absent observation is Out, so a dead channel silently becomes positive evidence of health. That is the
// CAPECO failure mode in one sentence -- a frozen level transmitter read as "the tank is not full".
//
// The mechanism: every channel owns an `unavailable` observation. When the channel cannot be believed, this layer
// asserts that observation and suppresses ALL of the channel's threshold observations. The casebook then reasons
// about the sensor failure explicitly, in arguments, where the witness can cite it.
//
// ARITHMETIC. No floating point anywhere on device. Authors write `7.1 mm/s` in the casebook and the compiler
// converts to scaled integers at build time, so the device performs integer comparisons only. Host-side floating
// point at compile time, integer comparisons at run time.
//
// Freestanding: no heap, no exceptions, no recursion, no static initialisation order, <cstdint>/<cstddef> only.

#include <cstddef>
#include <cstdint>

namespace quorum::binding {

/// Values are carried as milli-units of whatever the channel declares: 7.1 mm/s is 7100. One uniform scale keeps
/// the device arithmetic trivial; the unit string is documentation carried through for the witness.
constexpr std::int32_t kScale = 1000;

enum class Status : std::uint8_t {
    Ok = 0,
    NotConfigured,
    BadChannel,
    CapacityExceeded,
    BadSpec,
};

/// Which side of the threshold asserts the observation.
enum class Sense : std::uint8_t {
    Above = 0,  ///< assert when the value rises to `on`, release when it falls to `off`
    Below = 1,  ///< assert when the value falls to `on`, release when it rises to `off`
};

/// A physical signal. Generated by cbc from a `channel` declaration; never hand-written.
struct ChannelSpec {
    std::int32_t valid_lo = 0;  ///< milli-units; a sample outside [lo, hi] is instrument nonsense, not data
    std::int32_t valid_hi = 0;
    /// How long a sample stays believable. Exceeded means unavailable. There is no "0 means never expire" escape
    /// hatch: a channel with no freshness requirement cannot be distinguished from a dead one, and offering the
    /// option would make the dangerous choice available.
    std::uint32_t stale_after_ms = 0;
    /// How long a value may sit unchanged before the channel is reported as flatlined. 0 disables the check.
    ///
    /// This is NOT staleness. A stale channel has stopped delivering samples; a flatlined channel delivers fresh
    /// samples that never move, which is what a failed 4-20 mA transmitter or a latched ADC actually does, and is
    /// what nobody at CAPECO detected.
    std::uint32_t flatline_after_ms = 0;
    /// How much movement counts as alive, in milli-units. Guards against dither being mistaken for signal.
    std::int32_t flatline_epsilon = 0;
    std::int32_t unavailable_obs = -1;  ///< observation asserted when this channel cannot be believed
    std::int32_t flatline_obs = -1;     ///< observation asserted when the value has stopped moving, or -1
};

/// One threshold on one channel. The hysteresis pair is required, not optional -- a bare threshold chatters, and a
/// chattering observation makes the framework oscillate between verdicts, which is the alarm-flooding failure this
/// product exists to avoid.
struct ThresholdSpec {
    std::int32_t channel = 0;
    std::int32_t observation = -1;
    Sense sense = Sense::Above;
    std::int32_t on = 0;   ///< milli-units; crossing this asserts
    std::int32_t off = 0;  ///< milli-units; crossing back past this releases
    /// How long the value must stay past `on` before the observation asserts. 0 asserts at once, as before.
    ///
    /// "Bearing temperature above 90 for 5 s" is how alarm philosophies are actually written (an on-delay, ISA-18.2),
    /// and it is what separates a real condition from a spike. It lives here, in the binding, and not in the
    /// framework, deliberately: the framework stays a function of the present presence mask, so exhaustive and
    /// symbolic validation still cover every state exactly. Time decides only WHEN a bit is set, never what a set
    /// bit means.
    ///
    /// The hold restarts whenever a sample falls back below `on` before it matures. Release is not delayed: once
    /// asserted, the observation releases at `off` exactly as without a hold, because delaying the release of an
    /// alarm condition is the dangerous direction.
    std::uint32_t hold_ms = 0;
};

/// Why a channel is not believable, for the witness. Ordered by how much it tells you.
enum class Health : std::uint8_t {
    Good = 0,
    NeverSampled,  ///< the device has booted but has not yet read this channel
    Faulted,       ///< the caller reported the read itself as failed
    OutOfRange,    ///< the last sample is outside the declared valid range
    Stale,         ///< no fresh sample within stale_after_ms
};

[[nodiscard]] constexpr const char* health_name(Health h) noexcept {
    switch (h) {
        case Health::Good: return "good";
        case Health::NeverSampled: return "never sampled";
        case Health::Faulted: return "read faulted";
        case Health::OutOfRange: return "out of range";
        case Health::Stale: return "stale";
    }
    return "unknown";
}

/// Turns samples into a presence mask.
///
/// Fixed capacity, no allocation, safe to place in static storage. `MaxChannels` and `MaxThresholds` come from the
/// generated header so a casebook's binding is sized exactly.
template <std::int32_t MaxChannels, std::int32_t MaxThresholds>
class Binding {
    static_assert(MaxChannels > 0, "a binding needs at least one channel");
    static_assert(MaxThresholds > 0, "a binding needs at least one threshold");

    static constexpr std::size_t kChannelSlots = static_cast<std::size_t>(MaxChannels);
    static constexpr std::size_t kThresholdSlots = static_cast<std::size_t>(MaxThresholds);

    [[nodiscard]] static constexpr std::size_t ix(std::int32_t i) noexcept {
        return static_cast<std::size_t>(i);
    }

public:
    constexpr Binding() noexcept = default;

    /// Install the generated tables. The spec arrays must outlive this object; they are `constexpr` in the
    /// generated header, so in practice they live in flash and are never copied to RAM.
    [[nodiscard]] Status configure(const ChannelSpec* channels,
                                   std::int32_t channel_count,
                                   const ThresholdSpec* thresholds,
                                   std::int32_t threshold_count) noexcept {
        if (channels == nullptr || thresholds == nullptr) { return Status::BadSpec; }
        if (channel_count < 0 || threshold_count < 0) { return Status::BadSpec; }
        if (channel_count > MaxChannels || threshold_count > MaxThresholds) {
            return Status::CapacityExceeded;
        }

        for (std::int32_t c = 0; c < channel_count; ++c) {
            const ChannelSpec& s = channels[ix(c)];
            if (s.valid_hi < s.valid_lo) { return Status::BadSpec; }
            // A channel with no freshness requirement can never be reported dead, which defeats the entire point
            // of this layer. Refuse it at configure time rather than discover it in the field.
            if (s.stale_after_ms == 0) { return Status::BadSpec; }
            if (s.unavailable_obs < 0) { return Status::BadSpec; }
        }
        for (std::int32_t t = 0; t < threshold_count; ++t) {
            const ThresholdSpec& s = thresholds[ix(t)];
            if (s.channel < 0 || s.channel >= channel_count) { return Status::BadSpec; }
            if (s.observation < 0) { return Status::BadSpec; }
            // Hysteresis must be a genuine deadband in the right direction, or it is not hysteresis.
            if (s.sense == Sense::Above && s.off > s.on) { return Status::BadSpec; }
            if (s.sense == Sense::Below && s.off < s.on) { return Status::BadSpec; }
        }

        channels_ = channels;
        thresholds_ = thresholds;
        channel_count_ = channel_count;
        threshold_count_ = threshold_count;

        // Boot state. Every channel is NeverSampled, so the very first mask reports every channel unavailable and
        // asserts no threshold at all. A binding layer that gives a clean bill of health before reading a single
        // sensor is the worst possible failure, so it is the default that has to be got right.
        for (std::int32_t c = 0; c < channel_count; ++c) {
            seen_[ix(c)] = false;
            faulted_[ix(c)] = false;
            value_[ix(c)] = 0;
            updated_ms_[ix(c)] = 0;
            moved_ms_[ix(c)] = 0;
            anchor_[ix(c)] = 0;
        }
        for (std::int32_t t = 0; t < threshold_count; ++t) {
            latched_[ix(t)] = false;
            pending_[ix(t)] = false;
            pending_since_ms_[ix(t)] = 0;
        }
        return Status::Ok;
    }

    /// Record a good sample, in milli-units.
    [[nodiscard]] Status sample(std::int32_t channel, std::int32_t milli, std::uint32_t now_ms) noexcept {
        if (channels_ == nullptr) { return Status::NotConfigured; }
        if (channel < 0 || channel >= channel_count_) { return Status::BadChannel; }

        const ChannelSpec& spec = channels_[ix(channel)];
        const bool in_range = milli >= spec.valid_lo && milli <= spec.valid_hi;

        // Flatline tracking runs off the last sample that actually MOVED, not the last sample received. Tracking
        // the latter would mean a transmitter repeating one value forever looks continuously fresh -- exactly the
        // condition this is here to catch.
        if (!seen_[ix(channel)] || !in_range) {
            anchor_[ix(channel)] = milli;
            moved_ms_[ix(channel)] = now_ms;
        } else {
            const std::int32_t delta = milli - anchor_[ix(channel)];
            const std::int32_t magnitude = delta < 0 ? -delta : delta;
            if (magnitude > spec.flatline_epsilon) {
                anchor_[ix(channel)] = milli;
                moved_ms_[ix(channel)] = now_ms;
            }
        }

        value_[ix(channel)] = milli;
        updated_ms_[ix(channel)] = now_ms;
        seen_[ix(channel)] = true;
        faulted_[ix(channel)] = false;

        // An out-of-range sample is instrument nonsense. It updates freshness -- the channel is talking -- but it
        // must never move a latch, because latching on garbage is how a spurious shutdown happens.
        if (in_range) { relatch(channel, milli, now_ms); }
        return Status::Ok;
    }

    /// Record that the read itself failed: no response on the bus, a 4-20 mA loop reading 2 mA, a checksum error.
    /// Distinct from an out-of-range value, and the witness reports it differently.
    [[nodiscard]] Status fault(std::int32_t channel, std::uint32_t now_ms) noexcept {
        if (channels_ == nullptr) { return Status::NotConfigured; }
        if (channel < 0 || channel >= channel_count_) { return Status::BadChannel; }
        faulted_[ix(channel)] = true;
        updated_ms_[ix(channel)] = now_ms;
        return Status::Ok;
    }

    /// Why this channel is or is not believable, evaluated at `now_ms`.
    [[nodiscard]] Health health(std::int32_t channel, std::uint32_t now_ms) const noexcept {
        if (channels_ == nullptr || channel < 0 || channel >= channel_count_) { return Health::NeverSampled; }
        if (!seen_[ix(channel)]) { return Health::NeverSampled; }
        if (faulted_[ix(channel)]) { return Health::Faulted; }

        const ChannelSpec& spec = channels_[ix(channel)];
        const std::int32_t v = value_[ix(channel)];
        if (v < spec.valid_lo || v > spec.valid_hi) { return Health::OutOfRange; }

        // Unsigned subtraction, deliberately. A device that has been running 50 days rolls `now_ms` through zero,
        // and computing the age as a signed difference would make every channel look freshly sampled at exactly the
        // moment the plant has been trusted longest. Modular arithmetic is correct for any interval below 2^32 ms.
        if (static_cast<std::uint32_t>(now_ms - updated_ms_[ix(channel)]) >= spec.stale_after_ms) {
            return Health::Stale;
        }
        return Health::Good;
    }

    /// Has this channel stopped moving? Only meaningful when `health` is Good.
    [[nodiscard]] bool flatlined(std::int32_t channel, std::uint32_t now_ms) const noexcept {
        if (channels_ == nullptr || channel < 0 || channel >= channel_count_) { return false; }
        const ChannelSpec& spec = channels_[ix(channel)];
        if (spec.flatline_after_ms == 0 || spec.flatline_obs < 0) { return false; }
        if (health(channel, now_ms) != Health::Good) { return false; }
        return static_cast<std::uint32_t>(now_ms - moved_ms_[ix(channel)]) >= spec.flatline_after_ms;
    }

    /// The presence mask to hand to the casebook.
    ///
    /// Two rules, and they are the whole contract:
    ///   1. an unbelievable channel asserts its `unavailable` observation and NONE of its thresholds;
    ///   2. a believable channel asserts its latched thresholds and not `unavailable`.
    ///
    /// The mask therefore never says "quiet" when it means "blind".
    [[nodiscard]] std::uint32_t mask(std::uint32_t now_ms) const noexcept {
        std::uint32_t m = 0;
        if (channels_ == nullptr) { return m; }

        for (std::int32_t c = 0; c < channel_count_; ++c) {
            const ChannelSpec& spec = channels_[ix(c)];
            if (health(c, now_ms) != Health::Good) {
                m |= obs_bit(spec.unavailable_obs);
                continue;
            }
            if (flatlined(c, now_ms)) { m |= obs_bit(spec.flatline_obs); }
        }

        for (std::int32_t t = 0; t < threshold_count_; ++t) {
            const ThresholdSpec& spec = thresholds_[ix(t)];
            if (!asserted(t, now_ms)) { continue; }
            if (health(spec.channel, now_ms) != Health::Good) { continue; }
            m |= obs_bit(spec.observation);
        }
        return m;
    }

    /// Is threshold `t` asserting at `now_ms`? Latched, or past `on` for at least its hold time.
    ///
    /// Evaluated at mask time as well as at sample time, so a hold matures on schedule even if no further sample
    /// arrives -- a channel that then goes quiet for too long is caught by staleness, not by this.
    [[nodiscard]] bool asserted(std::int32_t t, std::uint32_t now_ms) const noexcept {
        if (t < 0 || t >= threshold_count_) { return false; }
        if (latched_[ix(t)]) { return true; }
        return pending_[ix(t)] &&
               static_cast<std::uint32_t>(now_ms - pending_since_ms_[ix(t)]) >= thresholds_[ix(t)].hold_ms;
    }

    [[nodiscard]] constexpr std::int32_t channel_count() const noexcept { return channel_count_; }
    [[nodiscard]] constexpr std::int32_t threshold_count() const noexcept { return threshold_count_; }

    /// The last accepted sample, in milli-units. For the witness, so a verdict can quote the number a human saw on
    /// the gauge rather than only the proposition it became.
    [[nodiscard]] std::int32_t value(std::int32_t channel) const noexcept {
        if (channel < 0 || channel >= channel_count_) { return 0; }
        return value_[ix(channel)];
    }

private:
    /// The presence-mask bit for an observation index.
    ///
    /// NAMED `obs_bit` AND NOT `bit`, WHICH IT WAS UNTIL A REAL BOARD REJECTED IT.
    ///
    /// The Arduino core's api/Common.h contains `#define bit(b) (1UL << (b))`, guarded only by `#ifndef bit` -- which
    /// a C++ function does not satisfy. The preprocessor therefore rewrote this function's own definition into
    /// `std::uint32_t (1UL << (observation))` and reported the error against Arduino's header, not this one.
    ///
    /// Second collision of this kind found by the first real vendor toolchain the code ever met; the other was an
    /// enumerator named `SysTick`, which CMSIS also #defines. Neither was caught by the portability gate, because
    /// that gate compiles against a stub Arduino.h containing none of the vendor macros.
    [[nodiscard]] static constexpr std::uint32_t obs_bit(std::int32_t observation) noexcept {
        if (observation < 0 || observation >= 32) { return 0U; }
        return 1U << static_cast<std::uint32_t>(observation);
    }

    void relatch(std::int32_t channel, std::int32_t milli, std::uint32_t now_ms) noexcept {
        for (std::int32_t t = 0; t < threshold_count_; ++t) {
            const ThresholdSpec& spec = thresholds_[ix(t)];
            if (spec.channel != channel) { continue; }
            const bool past_on = spec.sense == Sense::Above ? milli >= spec.on : milli <= spec.on;
            const bool past_off = spec.sense == Sense::Above ? milli <= spec.off : milli >= spec.off;
            // A matured hold becomes a latch before this sample is judged, so a sample in the deadband after the
            // hold has elapsed keeps the observation asserted, as hysteresis requires.
            if (asserted(t, now_ms)) { latched_[ix(t)] = true; }
            if (past_on) {
                if (!latched_[ix(t)] && !pending_[ix(t)]) {
                    pending_[ix(t)] = true;
                    pending_since_ms_[ix(t)] = now_ms;
                }
                if (spec.hold_ms == 0U) { latched_[ix(t)] = true; }
            } else {
                // Fell back before maturing: the condition was not sustained, so the hold starts again next time.
                pending_[ix(t)] = false;
                if (past_off) { latched_[ix(t)] = false; }
            }
            if (latched_[ix(t)]) { pending_[ix(t)] = false; }
            // Between `on` and `off` a latch deliberately holds its previous state. That band is the deadband.
        }
    }

    const ChannelSpec* channels_ = nullptr;
    const ThresholdSpec* thresholds_ = nullptr;
    std::int32_t channel_count_ = 0;
    std::int32_t threshold_count_ = 0;

    std::int32_t value_[kChannelSlots]{};
    std::uint32_t updated_ms_[kChannelSlots]{};
    std::int32_t anchor_[kChannelSlots]{};     ///< last value considered to be movement
    std::uint32_t moved_ms_[kChannelSlots]{};  ///< when that movement was seen
    bool seen_[kChannelSlots]{};
    bool faulted_[kChannelSlots]{};

    bool latched_[kThresholdSlots]{};
    bool pending_[kThresholdSlots]{};               ///< past `on`, waiting out the hold
    std::uint32_t pending_since_ms_[kThresholdSlots]{};
};

// ── timed readings ────────────────────────────────────────────────────────────────────────────────────────────────
//
// A `reading` declaration in a casebook is a yes/no reading the device works out from OTHER readings over time:
//
//   reading spike_after_start "..." when pressure_high within 10s after motor_started    (After)
//   reading recent_overheat   "..." when bearing_hot within last 5m                       (Recent)
//   reading repeated_trips    "..." when trip_seen 3 times in 1h                          (Count)
//
// Like the threshold hold above, time lives here and not in the framework. The result is one presence bit, so the
// framework stays a function of the present mask and exhaustive validation, --symbolic and --certificate still cover
// every state exactly. What they cannot cover is whether the bit is set at the right moments; that is this class's
// job, and test_binding checks it.
//
// SAMPLED, NOT CONTINUOUS. A timer sees its sources only when `step` is called, so an edge is the first step at which
// a source is seen set after a step at which it was clear, and a pulse shorter than the step interval can be missed.
// The runtime steps every millisecond in Modbus mode and at every evaluation.
//
// START-UP. Before the first step every source counts as clear, so a source already set at start-up counts as having
// just become set. A timed reading therefore cannot assume quiet history it never saw.

enum class TimerKind : std::uint8_t {
    After = 0,   ///< set when `source` becomes set within `window_ms` after `after` became set; clears with `source`
    Recent = 1,  ///< set while `source` is set and for `window_ms` after it was last seen set
    Count = 2,   ///< set while `source` has become set at least `times` times within the last `window_ms`
    First = 3,   ///< set while `source` is set and became set no more than `window_ms` ago: a start-up window
    Held = 4,    ///< set while `source` is set and became set at least `window_ms` ago: an on-delay
};

/// The most edges a Count timer remembers, and so the largest `times` it accepts.
constexpr std::int32_t kMaxTimerCount = 16;

/// One timed reading. Generated by cbc from a `reading` declaration; never hand-written.
struct TimerSpec {
    TimerKind kind = TimerKind::Recent;
    std::int32_t observation = -1;  ///< the presence bit this timer sets
    std::int32_t source = -1;       ///< the reading it watches
    std::int32_t after = -1;        ///< After only: the reading that must come first; otherwise -1
    std::uint32_t window_ms = 0;
    std::int32_t times = 0;         ///< Count only: 2..kMaxTimerCount; otherwise 0
};

/// Turns the history of presence bits into timed readings. Fixed capacity, no allocation.
template <std::int32_t MaxTimers>
class Timers {
    static_assert(MaxTimers > 0, "a timer table needs at least one slot");
    static constexpr std::size_t kSlots = static_cast<std::size_t>(MaxTimers);
    static constexpr std::size_t kRing = static_cast<std::size_t>(kMaxTimerCount);

    [[nodiscard]] static constexpr std::size_t ix(std::int32_t i) noexcept { return static_cast<std::size_t>(i); }
    [[nodiscard]] static constexpr bool set(std::uint32_t mask, std::int32_t obs) noexcept {
        return obs >= 0 && obs < 32 && (mask & (1U << static_cast<std::uint32_t>(obs))) != 0U;
    }
    [[nodiscard]] static constexpr std::uint32_t obs_bit(std::int32_t obs) noexcept {
        return obs < 0 || obs >= 32 ? 0U : 1U << static_cast<std::uint32_t>(obs);
    }

public:
    constexpr Timers() noexcept = default;

    /// Install the generated table and forget all history. `observations` is the casebook's observation count.
    [[nodiscard]] Status configure(const TimerSpec* specs, std::int32_t count, std::int32_t observations) noexcept {
        const Status v = validate(specs, count, observations);
        if (v != Status::Ok) { return v; }
        std::uint32_t outputs = 0;
        for (std::int32_t t = 0; t < count; ++t) { outputs |= obs_bit(specs[ix(t)].observation); }
        specs_ = specs;
        count_ = count;
        outputs_ = outputs;
        for (std::size_t t = 0; t < kSlots; ++t) {
            prev_source_[t] = false;
            prev_after_[t] = false;
            seen_[t] = false;
            last_ms_[t] = 0;
            out_[t] = false;
            head_[t] = 0;
            filled_[t] = 0;
            for (std::size_t k = 0; k < kRing; ++k) { ring_[t][k] = 0; }
        }
        return Status::Ok;
    }

    /// The checks configure() applies, without the storage: for an image loader that must refuse a bad table.
    [[nodiscard]] static Status validate(const TimerSpec* specs, std::int32_t count, std::int32_t observations) noexcept {
        if (specs == nullptr || count < 0 || observations < 0 || observations > 32) { return Status::BadSpec; }
        if (count > MaxTimers) { return Status::CapacityExceeded; }
        std::uint32_t outputs = 0;
        for (std::int32_t t = 0; t < count; ++t) {
            const TimerSpec& s = specs[ix(t)];
            const auto obs = [observations](std::int32_t o) noexcept { return o >= 0 && o < observations; };
            if (!obs(s.observation) || !obs(s.source) || s.source == s.observation || s.window_ms == 0U) {
                return Status::BadSpec;
            }
            if ((outputs & obs_bit(s.observation)) != 0U) { return Status::BadSpec; }
            outputs |= obs_bit(s.observation);
            switch (s.kind) {
                case TimerKind::After:
                    if (!obs(s.after) || s.after == s.source || s.after == s.observation || s.times != 0) {
                        return Status::BadSpec;
                    }
                    break;
                case TimerKind::Recent:
                case TimerKind::First:
                case TimerKind::Held:
                    if (s.after != -1 || s.times != 0) { return Status::BadSpec; }
                    break;
                case TimerKind::Count:
                    if (s.after != -1 || s.times < 2 || s.times > kMaxTimerCount) { return Status::BadSpec; }
                    break;
                default: return Status::BadSpec;
            }
        }
        // A timer may watch another timer's output only if that timer comes EARLIER in the table. Timers are stepped
        // in table order, so each sees the outputs it watches already brought up to date, and a loop (two timers
        // watching each other) cannot be written down at all.
        std::uint32_t earlier = 0;
        for (std::int32_t t = 0; t < count; ++t) {
            const std::uint32_t watched = obs_bit(specs[ix(t)].source) | obs_bit(specs[ix(t)].after);
            if ((watched & outputs & ~earlier) != 0U) { return Status::BadSpec; }
            earlier |= obs_bit(specs[ix(t)].observation);
        }
        return Status::Ok;
    }

    /// How many ms after `now_ms` the next timer output can change by time alone, with the readings unchanged: the
    /// earliest moment a "within last", "times in" or "within first" reading that is set now expires, or a "for"
    /// reading whose source is set comes on. False if none can. A device
    /// that steps every millisecond never needs this; a clock that jumps (the test clock) steps at each such moment
    /// on its way, so a timer that watches another sees it expire when it really does.
    [[nodiscard]] bool next_change(std::uint32_t now_ms, std::uint32_t& in_ms) const noexcept {
        bool any = false;
        in_ms = 0;
        for (std::int32_t t = 0; t < count_; ++t) {
            const std::size_t i = ix(t);
            const TimerSpec& s = specs_[i];
            if (s.kind == TimerKind::Held) {
                // A Held output changes by time alone when it turns ON: the run reaches window_ms.
                if (out_[i] || !seen_[i]) { continue; }
                const std::uint32_t age = now_ms - last_ms_[i];
                const std::uint32_t d = age < s.window_ms ? s.window_ms - age : 1U;
                if (!any || d < in_ms) { in_ms = d; }
                any = true;
                continue;
            }
            if (!out_[i] || s.kind == TimerKind::After) { continue; }  // an After clears only when its source does
            std::uint32_t at = last_ms_[i];
            if (s.kind == TimerKind::Count) {
                at = ring_[i][ix((head_[i] - s.times + kMaxTimerCount) % kMaxTimerCount)];
            }
            const std::uint32_t age = now_ms - at;  // <= window, or the output would not be set
            const std::uint32_t d = age < s.window_ms ? s.window_ms - age + 1U : 1U;
            if (!any || d < in_ms) { in_ms = d; }
            any = true;
        }
        return any;
    }

    /// The presence bits the timers own. The runtime clears these from any mask written from outside.
    [[nodiscard]] constexpr std::uint32_t outputs() const noexcept { return outputs_; }
    [[nodiscard]] constexpr std::int32_t count() const noexcept { return count_; }

    /// Advance every timer to `now_ms` given the base readings `base` (everything except timer outputs), and return
    /// the timer bits to OR into the mask. Timers are stepped in table order, and a timer that watches an earlier
    /// timer sees that timer's output for this same step. Calling it twice at the same time with the same base changes nothing.
    std::uint32_t step(std::uint32_t base, std::uint32_t now_ms) noexcept {
        std::uint32_t m = 0;
        base &= ~outputs_;  // a timer's output comes from the timer, never from outside
        for (std::int32_t t = 0; t < count_; ++t) {
            const TimerSpec& s = specs_[ix(t)];
            const std::size_t i = ix(t);
            const std::uint32_t seen = base | m;  // base readings, and the timers stepped so far
            const bool src = set(seen, s.source);
            const bool rose = src && !prev_source_[i];
            // Unsigned differences throughout, so a millisecond counter rolling through zero after 49.7 days does not
            // make an old event look new.
            const auto within = [now_ms, &s](std::uint32_t at) noexcept {
                return static_cast<std::uint32_t>(now_ms - at) <= s.window_ms;
            };
            switch (s.kind) {
                case TimerKind::After: {
                    const bool first = set(seen, s.after);
                    // The earlier reading is taken first, so both becoming set in the same step counts as "after".
                    if (first && !prev_after_[i]) {
                        seen_[i] = true;
                        last_ms_[i] = now_ms;
                    }
                    prev_after_[i] = first;
                    if (rose) { out_[i] = seen_[i] && within(last_ms_[i]); }
                    if (!src) { out_[i] = false; }
                    // Forget an expired start, so that 49.7 days later, when the clock has come round again, it does
                    // not look recent. Harmless otherwise: an expired start can never satisfy `within` again.
                    if (seen_[i] && !within(last_ms_[i])) { seen_[i] = false; }
                    break;
                }
                case TimerKind::Recent:
                    if (src) {
                        seen_[i] = true;
                        last_ms_[i] = now_ms;
                    }
                    out_[i] = seen_[i] && within(last_ms_[i]);
                    if (!out_[i]) { seen_[i] = false; }  // forgotten once expired, for the same reason
                    break;
                case TimerKind::First:
                case TimerKind::Held:
                    // last_ms_ is when the source's current run began; seen_ whether it is in a run at all.
                    if (rose) { last_ms_[i] = now_ms; }
                    seen_[i] = src;
                    if (!src) {
                        out_[i] = false;
                    } else if (s.kind == TimerKind::First) {
                        // Once the window has passed it stays clear for the rest of the run, so a run longer than the
                        // clock can count (49.7 days) cannot bring it back.
                        out_[i] = (rose || out_[i]) && within(last_ms_[i]);
                    } else {
                        // Once held long enough it stays set for the rest of the run, so a run longer than the clock
                        // can count (49.7 days) cannot make it drop.
                        out_[i] = out_[i] || static_cast<std::uint32_t>(now_ms - last_ms_[i]) >= s.window_ms;
                    }
                    break;
                case TimerKind::Count: {
                    if (rose) {
                        ring_[i][ix(head_[i])] = now_ms;
                        head_[i] = (head_[i] + 1) % kMaxTimerCount;
                        if (filled_[i] < kMaxTimerCount) { ++filled_[i]; }
                    }
                    // Drop the edges that have left the window, oldest first, so none can come back after a wrap.
                    while (filled_[i] > 0 &&
                           !within(ring_[i][ix((head_[i] - filled_[i] + kMaxTimerCount) % kMaxTimerCount)])) {
                        --filled_[i];
                    }
                    // The `times`-th most recent edge must still be inside the window.
                    if (filled_[i] >= s.times) {
                        const std::int32_t at = (head_[i] - s.times + kMaxTimerCount) % kMaxTimerCount;
                        out_[i] = within(ring_[i][ix(at)]);
                    } else {
                        out_[i] = false;
                    }
                    break;
                }
            }
            prev_source_[i] = src;
            if (out_[i]) { m |= obs_bit(s.observation); }
        }
        return m;
    }

private:
    const TimerSpec* specs_ = nullptr;
    std::int32_t count_ = 0;
    std::uint32_t outputs_ = 0;
    bool prev_source_[kSlots]{};
    bool prev_after_[kSlots]{};
    bool seen_[kSlots]{};            ///< After: `after` has become set at least once; Recent: `source` has been set;
                                     ///< First and Held: `source` is set now
    std::uint32_t last_ms_[kSlots]{};
    bool out_[kSlots]{};
    std::uint32_t ring_[kSlots][kRing]{};  ///< Count: when the source last became set, newest at head_ - 1
    std::int32_t head_[kSlots]{};
    std::int32_t filled_[kSlots]{};
};

}  // namespace quorum::binding
